## main/Kconfig.projbuild
```kconfig
menu "UM Series[D] Board Configuration"

    choice
        prompt "Select UM Series[D] board"
        default UM_BOARD_PROS3
        config UM_BOARD_FEATHERS3
            bool "FeatherS3"
        config UM_BOARD_PROS3
            bool "ProS3"
        config UM_BOARD_TINYS3
            bool "TinyS3"
        config UM_BOARD_EDGES3D
            bool "EdgeS3D"
    endchoice

    config UM_LDO2_PIN
        int
        default 17 if UM_BOARD_PROS3
        default 39 if UM_BOARD_FEATHERS3

    config UM_RGB_PWR_PIN
        int
        default UM_LDO2_PIN if UM_BOARD_PROS3
        default UM_LDO2_PIN if UM_BOARD_FEATHERS3
        default 17 if UM_BOARD_TINYS3

    config UM_RGB_DATA_PIN
        int
        default 18 if UM_BOARD_PROS3
        default 40 if UM_BOARD_FEATHERS3
        default 18 if UM_BOARD_TINYS3

    config UM_I2C_SDA_PIN
        int
        default 8 if UM_BOARD_PROS3
        default 8 if UM_BOARD_FEATHERS3
        default 8 if UM_BOARD_TINYS3
        default 8 if UM_BOARD_EDGES3D

    config UM_I2C_SCL_PIN
        int
        default 9 if UM_BOARD_PROS3
        default 9 if UM_BOARD_FEATHERS3
        default 9 if UM_BOARD_TINYS3
        default 9 if UM_BOARD_EDGES3D

    config UM_VBUS_SENSE_PIN
        int
        default 33 if UM_BOARD_PROS3
        default 34 if UM_BOARD_FEATHERS3
        default 33 if UM_BOARD_TINYS3

    config UM_LED_BUILTIN_PIN
        int
        default 13 if UM_BOARD_FEATHERS3

    menu "Example Selection"
        choice
            prompt "Select example to build"
            default EXAMPLE_COLORWHEEL
            config EXAMPLE_COLORWHEEL
                bool "Color Wheel Example"
                depends on UM_BOARD_PROS3 || UM_BOARD_FEATHERS3 || UM_BOARD_TINYS3
            config EXAMPLE_BATTERY_CHECK
                bool "Battery Check Example"
                depends on UM_BOARD_PROS3 || UM_BOARD_FEATHERS3 || UM_BOARD_TINYS3
            config EXAMPLE_BLINK
                bool "Blink Example"
        endchoice
    endmenu

    orsource "$IDF_PATH/examples/common_components/env_caps/$IDF_TARGET/Kconfig.env_caps"


    choice BLINK_LED
        prompt "Blink LED type"
        depends on EXAMPLE_BLINK
        default BLINK_LED_STRIP if UM_BOARD_PROS3 || UM_BOARD_FEATHERS3 || UM_BOARD_TINYS3
        default BLINK_LED_GPIO if UM_BOARD_EDGES3D
        help
            Select the LED type. A normal level controlled LED or an addressable LED strip.
            The default selection is based on the Espressif DevKit boards.
            You can change the default selection according to your board.

        config BLINK_LED_STRIP
            bool "RBG LED"
            depends on UM_BOARD_PROS3 || UM_BOARD_FEATHERS3 || UM_BOARD_TINYS3

        config BLINK_BLUE_LED
            bool "Blue LED"
            depends on UM_BOARD_FEATHERS3

        config BLINK_LED_GPIO
            bool "GPIO"
            depends on UM_BOARD_EDGES3D || UM_BOARD_PROS3 || UM_BOARD_FEATHERS3 || UM_BOARD_TINYS3
    endchoice

    config BLINK_BLUE
        depends on BLINK_BLUE_LED && EXAMPLE_BLINK
        int
        default UM_LED_BUILTIN_PIN if UM_BOARD_FEATHERS3

    config BLINK_GPIO
        depends on BLINK_LED_GPIO && EXAMPLE_BLINK
        int "External GPIO number to blink"
        range ENV_GPIO_RANGE_MIN ENV_GPIO_OUT_RANGE_MAX
        default 8
        help
            GPIO number (IOxx) for manual external LED blinking.
            Only shown for GPIO mode. For other modes, board defaults are used.
            Some GPIOs are used for other purposes (flash connections, etc.) and cannot be used to blink.

    config BLINK_PERIOD
        depends on EXAMPLE_BLINK
        int "Blink period in ms"
        range 10 3600000
        default 1000
        help
            Define the blinking period in milliseconds.

endmenu
```

## sdkconfig.defaults.esp32s3
```kconfig
CONFIG_BLINK_LED_STRIP=y
#
# RGB Data pin for ProS3 and TinyS3 is 18
# RGB Data pin for FeatherS3 is 40
#
CONFIG_BLINK_GPIO=18
```
